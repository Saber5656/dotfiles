## zmk/zmk-config/config/west.yml
```yaml
manifest:
  remotes:
    - name: zmkfirmware
      url-base: https://github.com/zmkfirmware

  projects:
    - name: eyelash_corne
      url: https://github.com/a741725193/zmk-new_corne
      revision: ba1eeab627ba94ac46f7768b3ddc01f97873ca87
    - name: zmk
      remote: zmkfirmware
      revision: v0.3.0
      import: app/west.yml

  self:
    path: config
```
